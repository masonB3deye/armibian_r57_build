// SPDX-License-Identifier: (GPL-2.0+ OR MIT)
/*
 * Copyright (c) 2023 Rockchip Electronics Co., Ltd.
 */

/dts-v1/;
#include "rk3576.dtsi"
#include "rk3576-u-boot.dtsi"
#include <dt-bindings/input/input.h>

/ {
	model = "Blueberry RK3576 EDGE V10 Board";
	compatible = "bluebrry,rk3576-edge-v10", "rockchip,rk3576";
};
